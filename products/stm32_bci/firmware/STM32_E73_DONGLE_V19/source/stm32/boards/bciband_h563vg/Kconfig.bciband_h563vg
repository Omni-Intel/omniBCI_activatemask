## products/stm32_bci/firmware/STM32_E73_DONGLE_V19/source/stm32/boards/bciband_h563vg/board.yml
```yaml
board:
  name: bciband_h563vg
  full_name: BCI-Band STM32H563VG
  vendor: custom
  socs:
    - name: stm32h563xx
```
